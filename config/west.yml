## config/west.yml
```yaml
manifest:
    remotes:
        - name: cakenes
          url-base: https://github.com/cakenes
    projects:
        - name: zmk
          remote: cakenes
          revision: main
          import: app/west.yml
    self:
        path: config
```
